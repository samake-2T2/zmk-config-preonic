## boards/arm/keyboardio_preonic/Kconfig.board
```kconfig
config BOARD_KEYBOARDIO_PREONIC
	bool "Keyboardio Preonic"
	depends on SOC_NRF52840_QIAA
	select NRF52_ERRATA_108
```

## boards/arm/keyboardio_preonic/Kconfig.defconfig
```kconfig
if BOARD_KEYBOARDIO_PREONIC

config BOARD
	default "keyboardio_preonic"

config ZMK_KEYBOARD_NAME
	default "Keyboardio Preonic"

# nRF52840 SoC를 위한 필수 설정값 포함
source "soc/arm/nordic_nrf/nrf52/Kconfig.defconfig.series"

endif
```

## boards/keyboardio/keyboardio_preonic/Kconfig.defconfig
```kconfig
if BOARD_KEYBOARDIO_PREONIC

config BOARD
	default "keyboardio_preonic"

config ZMK_KEYBOARD_NAME
	default "Keyboardio Preonic"

config ZMK_BOARD_COMPAT
	default y

endif
```

## boards/keyboardio/keyboardio_preonic/board.yml
```yaml
board:
  name: keyboardio_preonic
  vendor: keyboardio
  socs:
    - name: nrf52840
      variants:
        - name: zmk
  runners:
    - nrfjprog
    - jlink
    - uf2
```

## boards/keyboardio/keyboardio_preonic/keyboardio_preonic_defconfig
```kconfig
CONFIG_SOC_SERIES_NRF52X=y
CONFIG_SOC_NRF52840_QIAA=y
CONFIG_BOARD_KEYBOARDIO_PREONIC=y
CONFIG_ZMK_USB=y
CONFIG_ZMK_BLE=y
CONFIG_GPIO=y
```

## boards/keyboardio/keyboardio_preonic/keyboardio_preonic_nrf52840_zmk_defconfig
```kconfig
CONFIG_BOARD_KEYBOARDIO_PREONIC=y

# Enable MPU (메모리 보호 및 안정성)
CONFIG_ARM_MPU=y

# enable GPIO
CONFIG_GPIO=y

# 부팅 멈춤 방지를 위한 설정
CONFIG_LOG=n
CONFIG_SERIAL=n
CONFIG_UART_INTERRUPT_DRIVEN=n

# 칩셋 초기화 안정화
CONFIG_CLOCK_CONTROL_NRF_K32SRC_RC=y
CONFIG_CLOCK_CONTROL_NRF_K32SRC_RC_CALIBRATION=y

# USB 인식 오류 방지 (기본 HID만 활성화)
CONFIG_USB_DEVICE_STACK=y
CONFIG_ZMK_USB=y
CONFIG_USB_DEVICE_VID=0x3496
CONFIG_USB_DEVICE_PID=0x0005
CONFIG_USB_DEVICE_MANUFACTURER="Keyboardio"
CONFIG_USB_DEVICE_PRODUCT="Preonic"

# Bluetooth 활성화
CONFIG_ZMK_BLE=y

# Rotary encoder events (노브 동작 핵심)
CONFIG_EC11=y
CONFIG_EC11_TRIGGER_GLOBAL_THREAD=y

# 안정성을 위해 임시로 절전 기능 비활성화
CONFIG_ZMK_SLEEP=n

# Butterfly LEDs use ZMK's "underglow" feature
CONFIG_ZMK_RGB_UNDERGLOW=y

# 메모리 파티션 및 설정 저장소 (부팅 및 페어링 유지 핵심)
CONFIG_USE_DT_CODE_PARTITION=y
CONFIG_MPU_ALLOW_FLASH_WRITE=y
CONFIG_NVS=y
CONFIG_SETTINGS_NVS=y
CONFIG_FLASH=y
CONFIG_FLASH_PAGE_LAYOUT=y
CONFIG_FLASH_MAP=y

# UF2 펌웨어 포맷 출력 활성화
CONFIG_BUILD_OUTPUT_UF2=y
```

## boards/keyboardio/preonic/Kconfig.preonic
```kconfig
config BOARD_KEYBOARDIO_PREONIC
	bool "Keyboardio Preonic"
	select SOC_NRF52840_QIAA
```

## boards/keyboardio/preonic/board.yml
```yaml
board:
  name: preonic
  vendor: keyboardio
  socs:
    - name: nrf52840
      variants:
        - name: zmk
```

## boards/shields/keyboardio_preonic/Kconfig.defconfig
```kconfig
# Copyright (c) 2021 The ZMK Contributors
# SPDX-License-Identifier: MIT

if SHIELD_KEYBOARDIO_PREONIC

config ZMK_KEYBOARD_NAME
    default "Keyboardio Preonic"

endif
```

## boards/shields/keyboardio_preonic/Kconfig.shield
```kconfig
# Copyright (c) 2021 The ZMK Contributors
# SPDX-License-Identifier: MIT

config SHIELD_KEYBOARDIO_PREONIC
    def_bool $(shields_list_contains,keyboardio_preonic)
```

## boards/shields/preonic_rev3_keyboardio_edition/Kconfig.defconfig
```kconfig
# Copyright (c) 2021 The ZMK Contributors
# SPDX-License-Identifier: MIT

if SHIELD_PREONIC_REV3_KEYBOARDIO_EDITION

config ZMK_KEYBOARD_NAME
    default "Keyboardio Preonic"

endif
```

## boards/shields/preonic_rev3_keyboardio_edition/Kconfig.shield
```kconfig
# Copyright (c) 2021 The ZMK Contributors
# SPDX-License-Identifier: MIT

config SHIELD_PREONIC_REV3_KEYBOARDIO_EDITION
    def_bool $(shields_list_contains,PREONIC_REV3_KEYBOARDIO_EDITION)
```

## config/boards/keyboardio_preonic/Kconfig.board
```kconfig
# Copyright (c) 2021 Pete Johanson
# SPDX-License-Identifier: MIT

config BOARD_KEYBOARDIO_PREONIC
	bool "Keyboardio Preonic"
	select SOC_NRF52840_QIAA
```

## config/boards/keyboardio_preonic/Kconfig.defconfig
```kconfig
# Copyright (c) 2021 Pete Johanson
# SPDX-License-Identifier: MIT

if BOARD_KEYBOARDIO_PREONIC

config BOARD
	default "keyboardio_preonic"

config ZMK_KEYBOARD_NAME
	default "Keyboardio Preonic"

endif
```

## config/west.yml
```yaml
manifest:
  remotes:
    - name: zmkfirmware
      url-base: https://github.com/zmkfirmware
    - name: keyboardio
      url-base: https://github.com/keyboardio
  projects:
    - name: zmk
      remote: zmkfirmware
      revision: v0.3
      import: app/west.yml
    - name: keyboardio-preonic-zmk-module
      remote: keyboardio
      revision: main
  self:
    path: config
```

## west.yml
```yaml
manifest:
  remotes:
    - name: zmkfirmware
      url-base: https://github.com/zmkfirmware
    - name: keyboardio
      url-base: https://github.com/keyboardio
  projects:
    - name: zmk
      remote: zmkfirmware
      revision: main
      import: app/west.yml
    - name: keyboardio-preonic-zmk-module
      remote: keyboardio
      revision: main
  self:
    path: config
```
